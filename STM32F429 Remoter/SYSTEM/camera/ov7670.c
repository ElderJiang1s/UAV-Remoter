#include "cm4.h"
#include "ov7670.h"  
#include "delay.h"
#include "usart.h"			 
#include "sccb.h"	
//////////////////////////////////////////////////////////////////////////////////	 
//本程序只供学习使用，未经作者许可，不得用于其它任何用途
//ALIENTEK STM32开发板
//OV7670 驱动代码	   
//正点原子@ALIENTEK
//技术论坛:www.openedv.com
//创建日期:2016/1/16
//版本：V1.0
//版权所有，盗版必究。
//Copyright(C) 广州市星翼电子科技有限公司 2014-2024
//All rights reserved									  
////////////////////////////////////////////////////////////////////////////////// 
 //初始化寄存器序列及其对应的值
const u8 ov7670_init_reg_tbl[][2]= 
{   
//	/*以下为OV7670 QVGA RGB565参数  */
//	{0x3a, 0x04},//dummy
//	{0x40, 0xd0},//565   
//	{0x12, 0x14},//QVGA,RGB输出

//	//输出窗口设置
//	{0x32, 0x80},//HREF control	bit[2:0] HREF start 3 LSB	 bit[5:3] HSTOP HREF end 3LSB
//	{0x17, 0x16},//HSTART start high 8-bit MSB         
//	{0x18, 0x04},//5 HSTOP end high 8-bit
//	{0x19, 0x02},
//	{0x1a, 0x7b},//0x7a,
//	{0x03, 0x06},//0x0a,帧竖直方向控制

//	{0x0c, 0x00},
//	{0x15, 0x00},//0x00
//	{0x3e, 0x00},//10
//	{0x70, 0x3a},
//	{0x71, 0x35},
//	{0x72, 0x11},
//	{0x73, 0x00},//

//	{0xa2, 0x02},//15
//	{0x11, 0x81},//时钟分频设置,0,不分频.
//	{0x7a, 0x20},
//	{0x7b, 0x1c},
//	{0x7c, 0x28},

//	{0x7d, 0x3c},//20
//	{0x7e, 0x55},
//	{0x7f, 0x68},
//	{0x80, 0x76},
//	{0x81, 0x80},

//	{0x82, 0x88},
//	{0x83, 0x8f},
//	{0x84, 0x96},
//	{0x85, 0xa3},
//	{0x86, 0xaf},

//	{0x87, 0xc4},//30
//	{0x88, 0xd7},
//	{0x89, 0xe8},
//	{0x13, 0xe0},
//	{0x00, 0x00},//AGC

//	{0x10, 0x00},
//	{0x0d, 0x00},//全窗口， 位[5:4]: 01 半窗口，10 1/4窗口，11 1/4窗口 
//	{0x14, 0x28},//0x38, limit the max gain
//	{0xa5, 0x05},
//	{0xab, 0x07},

//	{0x24, 0x75},//40
//	{0x25, 0x63},
//	{0x26, 0xA5},
//	{0x9f, 0x78},
//	{0xa0, 0x68},

//	{0xa1, 0x03},//0x0b,
//	{0xa6, 0xdf},//0xd8,
//	{0xa7, 0xdf},//0xd8,
//	{0xa8, 0xf0},
//	{0xa9, 0x90},

//	{0xaa, 0x94},//50
//	{0x13, 0xe5},
//	{0x0e, 0x61},
//	{0x0f, 0x4b},
//	{0x16, 0x02},

//	{0x1e, 0x07},//图像输出镜像控制.0x07
//	{0x21, 0x02},
//	{0x22, 0x91},
//	{0x29, 0x07},
//	{0x33, 0x0b},

//	{0x35, 0x0b},//60
//	{0x37, 0x1d},
//	{0x38, 0x71},
//	{0x39, 0x2a},
//	{0x3c, 0x78},

//	{0x4d, 0x40},
//	{0x4e, 0x20},
//	{0x69, 0x00},
//	{0x6b, 0x40},//PLL*4=48Mhz
//	{0x74, 0x19},
//	{0x8d, 0x4f},

//	{0x8e, 0x00},//70
//	{0x8f, 0x00},
//	{0x90, 0x00},
//	{0x91, 0x00},
//	{0x92, 0x00},//0x19,//0x66

//	{0x96, 0x00},
//	{0x9a, 0x80},
//	{0xb0, 0x84},
//	{0xb1, 0x0c},
//	{0xb2, 0x0e},

//	{0xb3, 0x82},//80
//	{0xb8, 0x0a},
//	{0x43, 0x14},
//	{0x44, 0xf0},
//	{0x45, 0x34},

//	{0x46, 0x58},
//	{0x47, 0x28},
//	{0x48, 0x3a},
//	{0x59, 0x88},
//	{0x5a, 0x88},

//	{0x5b, 0x44},//90
//	{0x5c, 0x67},
//	{0x5d, 0x49},
//	{0x5e, 0x0e},
//	{0x64, 0x04},
//	{0x65, 0x20},

//	{0x66, 0x05},
//	{0x94, 0x04},
//	{0x95, 0x08},
//	{0x6c, 0x0a},
//	{0x6d, 0x55},


//	{0x4f, 0x80},
//	{0x50, 0x80},
//	{0x51, 0x00},
//	{0x52, 0x22},
//	{0x53, 0x5e},
//	{0x54, 0x80},

//	//{0x54, 0x40},//110


//	{0x09, 0x03},//驱动能力最大

//	{0x6e, 0x11},//100
//	{0x6f, 0x9f},//0x9e for advance AWB
//	{0x55, 0x00},//亮度
//	{0x56, 0x40},//对比度 0x40
//	{0x57, 0x40},//0x40,  change according to Jim's request
/////////////////////////////////////////////////////////////////////////
////以下部分代码由开源电子网网友:duanzhang512 提出
////添加此部分代码将可以获得更好的成像效果,但是最下面一行会有蓝色的抖动.
////如不想要,可以屏蔽此部分代码.然后将:OV7670_Window_Set(12,176,240,320);
////改为:OV7670_Window_Set(12,174,240,320);,即可去掉最下一行的蓝色抖动
//	{0x6a, 0x40},
//	{0x01, 0x40},
//	{0x02, 0x40},
//	{0x13, 0xe7},
//	{0x15, 0x00},  
//	
//		
//	{0x58, 0x9e},
//	
//	{0x41, 0x08},
//	{0x3f, 0x00},
//	{0x75, 0x05},
//	{0x76, 0xe1},
//	{0x4c, 0x00},
//	{0x77, 0x01},
//	{0x3d, 0xc2},	
//	{0x4b, 0x09},
//	{0xc9, 0x60},
//	{0x41, 0x38},
//	
//	{0x34, 0x11},
//	{0x3b, 0x02}, 

//	{0xa4, 0x89},
//	{0x96, 0x00},
//	{0x97, 0x30},
//	{0x98, 0x20},
//	{0x99, 0x30},
//	{0x9a, 0x84},
//	{0x9b, 0x29},
//	{0x9c, 0x03},
//	{0x9d, 0x4c},
//	{0x9e, 0x3f},
//	{0x78, 0x04},
//	
//	{0x79, 0x01},
//	{0xc8, 0xf0},
//	{0x79, 0x0f},
//	{0xc8, 0x00},
//	{0x79, 0x10},
//	{0xc8, 0x7e},
//	{0x79, 0x0a},
//	{0xc8, 0x80},
//	{0x79, 0x0b},
//	{0xc8, 0x01},
//	{0x79, 0x0c},
//	{0xc8, 0x0f},
//	{0x79, 0x0d},
//	{0xc8, 0x20},
//	{0x79, 0x09},
//	{0xc8, 0x80},
//	{0x79, 0x02},
//	{0xc8, 0xc0},
//	{0x79, 0x03},
//	{0xc8, 0x40},
//	{0x79, 0x05},
//	{0xc8, 0x30},
//	{0x79, 0x26}, 
//	{0x09, 0x00},
///////////////////////////////////////////////////////////////////////
 {0x3a, 0x04},
    {0x40, 0x10},
    {0x12, 0x14},
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    {0x2d, 0x01},  
		
	//	 {0x70, 0x00},
  //  {0x71, 0x80},  

}; 



//OV7670写寄存器
//返回值:0,成功;1,失败.
u8 OV7670_WR_Reg(u16 reg,u8 data)
{
	u8 res=0;
	SCCB_Start(); 					//启动SCCB传输
	if(SCCB_WR_Byte(OV7670_ADDR))res=1;	//写器件ID	  
//   	if(SCCB_WR_Byte(reg>>8))res=1;	//写寄存器高8位地址
   	if(SCCB_WR_Byte(reg))res=1;		//写寄存器低8位地址		  
   	if(SCCB_WR_Byte(data))res=1; 	//写数据	 
  	SCCB_Stop();	  
  	return	res;
}
//OV7670读寄存器
//返回值:读到的寄存器值
u8 OV7670_RD_Reg(u16 reg)
{
	u8 val=0;
	SCCB_Start(); 				//启动SCCB传输
	SCCB_WR_Byte(OV7670_ADDR);	//写器件ID
 //  	SCCB_WR_Byte(reg>>8);	    //写寄存器高8位地址   
  	SCCB_WR_Byte(reg);			//写寄存器低8位地址	  
	SCCB_Stop();   
	//设置寄存器地址后，才是读
	SCCB_Start();
	SCCB_WR_Byte(OV7670_ADDR|0X01);//发送读命令	  
   	val=SCCB_RD_Byte();		 	//读取数据
  	SCCB_No_Ack();
  	SCCB_Stop();
  	return val;
}
 

//初始化OV7670 
//配置完以后,默认输出是1600*1200尺寸的图片!! 
//返回值:0,成功
//    其他,错误代码
u8 OV7670_Init(void)
{ 
	u16 i=0;
	u16 reg;
		//设置IO     	
	GPIO_InitTypeDef GPIO_Initure;
	__HAL_RCC_GPIOG_CLK_ENABLE();			//开启GPIOG时钟
	GPIO_Initure.Pin=GPIO_PIN_9|GPIO_PIN_15;           //PG15
	GPIO_Initure.Mode=GPIO_MODE_OUTPUT_PP;  //推挽输出
	GPIO_Initure.Pull=GPIO_PULLUP;          //上拉
    GPIO_Initure.Speed=GPIO_SPEED_HIGH;     //高速
    HAL_GPIO_Init(GPIOG,&GPIO_Initure);     //初始化
	OV7670_RST=0;			//必须先拉低OV7670的RST脚,再上电
	delay_ms(20); 
	OV7670_PWDN=0;		//POWER ON=0
	delay_ms(5);  
	OV7670_RST=1;			//结束复位 
	delay_ms(20);      
	SCCB_Init();			//初始化SCCB 的IO口 
	delay_ms(5); 
		if(OV7670_WR_Reg(0x12,0x80))return 1;	//复位SCCB	  
	delay_ms(50);  
	//读取产品型号
 	reg=OV7670_RD_Reg(0x0b);   
	if(reg!=0x73)return 2;  
 	reg=OV7670_RD_Reg(0x0a);   
	if(reg!=0x76)return 2;
	//初始化序列	  
	for(i=0;i<sizeof(ov7670_init_reg_tbl)/sizeof(ov7670_init_reg_tbl[0]);i++)
	{
	   	OV7670_WR_Reg(ov7670_init_reg_tbl[i][0],ov7670_init_reg_tbl[i][1]);
  }
   	return 0x00; 	//ok
} 
////////////////////////////////////////////////////////////////////////////
//OV7670功能设置
//白平衡设置
//0:自动
//1:太阳sunny
//2,阴天cloudy
//3,办公室office
//4,家里home
void OV7670_Light_Mode(u8 mode)
{
	u8 reg13val=0XE7;//默认就是设置为自动白平衡
	u8 reg01val=0;
	u8 reg02val=0;
	switch(mode)
	{
		case 1://sunny
			reg13val=0XE5;
			reg01val=0X5A;
			reg02val=0X5C;
			break;	
		case 2://cloudy
			reg13val=0XE5;
			reg01val=0X58;
			reg02val=0X60;
			break;	
		case 3://office
			reg13val=0XE5;
			reg01val=0X84;
			reg02val=0X4c;
			break;	
		case 4://home
			reg13val=0XE5;
			reg01val=0X96;
			reg02val=0X40;
			break;	
	}
	OV7670_WR_Reg(0X13,reg13val);//COM8设置 
	OV7670_WR_Reg(0X01,reg01val);//AWB蓝色通道增益 
	OV7670_WR_Reg(0X02,reg02val);//AWB红色通道增益 
}				  
//色度设置
//0:-2
//1:-1
//2,0
//3,1
//4,2
void OV7670_Color_Saturation(u8 sat)
{
	u8 reg4f5054val=0X80;//默认就是sat=2,即不调节色度的设置
 	u8 reg52val=0X22;
	u8 reg53val=0X5E;
 	switch(sat)
	{
		case 0://-2
			reg4f5054val=0X40;  	 
			reg52val=0X11;
			reg53val=0X2F;	 	 
			break;	
		case 1://-1
			reg4f5054val=0X66;	    
			reg52val=0X1B;
			reg53val=0X4B;	  
			break;	
		case 3://1
			reg4f5054val=0X99;	   
			reg52val=0X28;
			reg53val=0X71;	   
			break;	
		case 4://2
			reg4f5054val=0XC0;	   
			reg52val=0X33;
			reg53val=0X8D;	   
			break;	
	}
	OV7670_WR_Reg(0X4F,reg4f5054val);	//色彩矩阵系数1
	OV7670_WR_Reg(0X50,reg4f5054val);	//色彩矩阵系数2 
	OV7670_WR_Reg(0X51,0X00);			//色彩矩阵系数3  
	OV7670_WR_Reg(0X52,reg52val);		//色彩矩阵系数4 
	OV7670_WR_Reg(0X53,reg53val);		//色彩矩阵系数5 
	OV7670_WR_Reg(0X54,reg4f5054val);	//色彩矩阵系数6  
	OV7670_WR_Reg(0X58,0X9E);			//MTXS 
}
//亮度设置
//0:-2
//1:-1
//2,0
//3,1
//4,2
void OV7670_Brightness(u8 bright)
{
	u8 reg55val=0X00;//默认就是bright=2
  	switch(bright)
	{
		case 0://-2
			reg55val=0XB0;	 	 
			break;	
		case 1://-1
			reg55val=0X98;	 	 
			break;	
		case 3://1
			reg55val=0X18;	 	 
			break;	
		case 4://2
			reg55val=0X30;	 	 
			break;	
	}
	OV7670_WR_Reg(0X55,reg55val);	//亮度调节 
}
//对比度设置
//0:-2
//1:-1
//2,0
//3,1
//4,2
void OV7670_Contrast(u8 contrast)
{
	u8 reg56val=0X40;//默认就是contrast=2
  	switch(contrast)
	{
		case 0://-2
			reg56val=0X30;	 	 
			break;	
		case 1://-1
			reg56val=0X38;	 	 
			break;	
		case 3://1
			reg56val=0X50;	 	 
			break;	
		case 4://2
			reg56val=0X60;	 	 
			break;	
	}
	OV7670_WR_Reg(0X56,reg56val);	//对比度调节 
}
//特效设置
//0:普通模式    
//1,负片
//2,黑白   
//3,偏红色
//4,偏绿色
//5,偏蓝色
//6,复古	    
void OV7670_Special_Effects(u8 eft)
{
	u8 reg3aval=0X04;//默认为普通模式
	u8 reg67val=0XC0;
	u8 reg68val=0X80;
	switch(eft)
	{
		case 1://负片
			reg3aval=0X24;
			reg67val=0X80;
			reg68val=0X80;
			break;	
		case 2://黑白
			reg3aval=0X14;
			reg67val=0X80;
			reg68val=0X80;
			break;	
		case 3://偏红色
			reg3aval=0X14;
			reg67val=0Xc0;
			reg68val=0X80;
			break;	
		case 4://偏绿色
			reg3aval=0X14;
			reg67val=0X40;
			reg68val=0X40;
			break;	
		case 5://偏蓝色
			reg3aval=0X14;
			reg67val=0X80;
			reg68val=0XC0;
			break;	
		case 6://复古
			reg3aval=0X14;
			reg67val=0XA0;
			reg68val=0X40;
			break;	 
	}
	OV7670_WR_Reg(0X3A,reg3aval);//TSLB设置 
	OV7670_WR_Reg(0X68,reg67val);//MANU,手动U值 
	OV7670_WR_Reg(0X67,reg68val);//MANV,手动V值 
}	
//设置图像输出窗口
//对QVGA设置。
void OV7670_Window_Set(u16 sx,u16 sy,u16 width,u16 height)
{
	u16 endx;
	u16 endy;
	u8 temp; 
	endx=sx+width*2;	//V*2
 	endy=sy+height*2;
	if(endy>784)endy-=784;
	temp=OV7670_RD_Reg(0X03);				//读取Vref之前的值
	temp&=0XF0;
	temp|=((endx&0X03)<<2)|(sx&0X03);
	OV7670_WR_Reg(0X03,temp);				//设置Vref的start和end的最低2位
	OV7670_WR_Reg(0X19,sx>>2);			//设置Vref的start高8位
	OV7670_WR_Reg(0X1A,endx>>2);			//设置Vref的end的高8位

	temp=OV7670_RD_Reg(0X32);				//读取Href之前的值
	temp&=0XC0;
	temp|=((endy&0X07)<<3)|(sy&0X07);
	OV7670_WR_Reg(0X17,sy>>3);			//设置Href的start高8位
	OV7670_WR_Reg(0X18,endy>>3);			//设置Href的end的高8位
}

 





